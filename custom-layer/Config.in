## custom-layer/Config.in
```kconfig
menu "Zewnętrzne pakiety"

source "$BR2_EXTERNAL_CUSTOM_LAYER_PATH/package/sysbench/Config.in"
source "$BR2_EXTERNAL_CUSTOM_LAYER_PATH/package/ck/Config.in"

endmenu
```

## custom-layer/package/ck/Config.in
```kconfig
config BR2_PACKAGE_CK
	bool "ck"
	depends on BR2_USE_WCHAR
	depends on BR2_TOOLCHAIN_HAS_THREADS
	help
	  Concurrency Kit: concurrency primitives, safe memory
	  reclamation mechanisms and lock-free data structures.
	  https://github.com/concurrencykit/ck
```

## custom-layer/package/sysbench/Config.in
```kconfig
config BR2_PACKAGE_SYSBENCH
	bool "sysbench"
	depends on !BR2_STATIC_LIBS
	depends on !BR2_PACKAGE_LUA
	depends on BR2_PACKAGE_LUAJIT_ARCH_SUPPORTS
	depends on !BR2_TOOLCHAIN_USES_UCLIBC
	depends on BR2_USE_WCHAR
	depends on BR2_TOOLCHAIN_HAS_THREADS
	select BR2_PACKAGE_LUAJIT
	select BR2_PACKAGE_CK
	help
	  Scriptable multi-threaded benchmark tool for
	  databases and systems.
	  https://github.com/akopytov/sysbench.git
```
